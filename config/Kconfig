## config/Kconfig
```kconfig
config EYELASH_DISPLAY_REFRESH
    bool "Periodically invalidate the whole screen (keeps the nice!view clone alive)"
    depends on ZMK_DISPLAY

config EYELASH_DISPLAY_REFRESH_MS
    int "Redraw interval in ms"
    default 200
    depends on EYELASH_DISPLAY_REFRESH
```

## config/boards/shields/eyelash_nice_view/Kconfig.defconfig
```kconfig
# nice!view 互換の画面部品（右手専用。絵の部分を自作画像にする）
# SPDX-License-Identifier: MIT

if SHIELD_EYELASH_NICE_VIEW

config LV_Z_VDB_SIZE
    default 100

config LV_DPI_DEF
    default 161

config LV_Z_BITS_PER_PIXEL
    default 1

choice LV_COLOR_DEPTH
    default LV_COLOR_DEPTH_1
endchoice

choice ZMK_DISPLAY_WORK_QUEUE
    default ZMK_DISPLAY_WORK_QUEUE_DEDICATED
endchoice

choice ZMK_DISPLAY_STATUS_SCREEN
    default ZMK_DISPLAY_STATUS_SCREEN_CUSTOM
endchoice

config LV_Z_MEM_POOL_SIZE
    default 4096 if ZMK_DISPLAY_STATUS_SCREEN_CUSTOM

config ZMK_DISPLAY_STATUS_SCREEN_CUSTOM
    imply EYELASH_NV_WIDGET_STATUS

config EYELASH_NV_WIDGET_STATUS
    bool "Eyelash nice!view status widget (peripheral)"
    select LV_FONT_MONTSERRAT_16
    select LV_USE_IMG
    select LV_USE_CANVAS

if !ZMK_SPLIT || ZMK_SPLIT_ROLE_CENTRAL

config EYELASH_NV_WIDGET_STATUS
    select LV_FONT_MONTSERRAT_14
    select LV_FONT_MONTSERRAT_48

endif # !ZMK_SPLIT || ZMK_SPLIT_ROLE_CENTRAL

if !ZMK_SPLIT_ROLE_CENTRAL

config USB_DEVICE_PRODUCT
    default "Eyelash Sofle Right"

endif

config ZMK_DISPLAY_STATUS_SCREEN_BUILT_IN
    select LV_FONT_MONTSERRAT_26

config EYELASH_ZMK_USB_WIDGET
    bool "Use ZMK USB state in the right-hand widget (unused)"
    default n

endif # SHIELD_EYELASH_NICE_VIEW
```

## config/boards/shields/eyelash_nice_view/Kconfig.shield
```kconfig
# SPDX-License-Identifier: MIT

config SHIELD_EYELASH_NICE_VIEW
    def_bool $(shields_list_contains,eyelash_nice_view)
```

## config/boards/shields/eyelash_sofle/Kconfig.defconfig
```kconfig
if SHIELD_EYELASH_SOFLE_LEFT

config ZMK_KEYBOARD_NAME
    default "Sofle"

config ZMK_SPLIT_ROLE_CENTRAL
    default y

endif

if SHIELD_EYELASH_SOFLE_LEFT || SHIELD_EYELASH_SOFLE_RIGHT

config ZMK_SPLIT
    default y

endif
```

## config/west.yml
```yaml
manifest:
  remotes:
    - name: zmkfirmware
      url-base: https://github.com/zmkfirmware
    - name: cormoran
      url-base: https://github.com/cormoran
  projects:
    - name: eyelash_sofle
      url: https://github.com/a741725193/zmk-sofle
      revision: cad147725279b0635a3d512ac99f6668bfec3704 # main (2026-10-05)
    - name: zmk
      remote: cormoran
      revision: 4493783ef88ce2e653bf8217c92ee17140df71e3 # v0.3-branch+dya
      import: app/west.yml
    - name: zmk-behavior-runtime-sensor-rotate
      remote: cormoran
      revision: 8b1125ed676c1f5e14145d217984f33d0ebdcef4 # main
    - name: zmk-module-ble-management
      remote: cormoran
      revision: 851661cd21f2aded8ec649da86e01a207dc4b973 # zmk-v0.3.0.0
    - name: zmk-module-battery-history
      remote: cormoran
      revision: 307755dd2ad4d320e14de162e8e5ef018f29d929 # main
    - name: zmk-module-settings-rpc
      remote: cormoran
      revision: 78f86df9e6c5edaf57bef3ccbd7f360cfdf49291 # main
    - name: zmk-module-runtime-input-processor
      remote: cormoran
      revision: dbf92f764de8b6ffd60bf5850514302875fe2570 # zmk-v0.3.0.0
  self:
    path: config
```
